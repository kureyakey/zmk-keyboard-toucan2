## boards/shields/toucan/Kconfig.defconfig
```kconfig
if SHIELD_TOUCAN_LEFT

config ZMK_KEYBOARD_NAME
    default "Toucan"

config ZMK_SPLIT_ROLE_CENTRAL
    default y

config ZMK_SPLIT_BLE_CENTRAL_BATTERY_LEVEL_FETCHING
    default y

config ZMK_SPLIT_BLE_CENTRAL_BATTERY_LEVEL_PROXY
    default y

endif



if SHIELD_TOUCAN_LEFT || SHIELD_TOUCAN_RIGHT

config SPI
    default y

config ZMK_SPLIT
    default y

if ZMK_KEYBOARD_YOUR_KEYBOARD

config ZMK_POINTING
    default y

config IQS7211E
    default y

endif

config RGBLED_WIDGET_BATTERY_LEVEL_HIGH
    default 40

endif
```

## config/west.yml
```yaml
manifest:
  remotes:
    - name: zmkfirmware
      url-base: https://github.com/zmkfirmware
    - name: caksoylar
      url-base: https://github.com/caksoylar
    - name: geeksville
      url-base: https://github.com/geeksville
    - name: beekeeb
      url-base: https://github.com/beekeeb
    - name: cormoran
      url-base: https://github.com/cormoran
    - name: kureyakey
      url-base: https://github.com/kureyakey
    - name: badjeff
      url-base: https://github.com/badjeff
      
  projects:
    - name: zmk
      remote: cormoran          
      revision: v0.3-branch+dya
      import: app/west.yml
      
    - name: zmk-module-ble-management
      remote: cormoran
      revision: zmk-v0.3.0.0
      
    - name: zmk-module-battery-history
      remote: cormoran
      revision: main
      
    - name: zmk-module-settings-rpc
      remote: cormoran
      revision: main
      
    - name: zmk-module-runtime-input-processor
      remote: cormoran
      revision: zmk-v0.3.0.0
      
    - name: zmk-behavior-runtime-sensor-rotate
      remote: cormoran
      revision: zmk-v0.3.0.0
      
    - name: zmk-rgbled-widget
      remote: caksoylar
      revision: v0.3
      
    - name: zmk_driver_azoteq
      remote: beekeeb
      revision: main
      
    - name: zmk-input-zoom
      remote: beekeeb
      revision: main
      
  self:
    path: config
```
